## main/Kconfig.projbuild
```kconfig
menu "Flight Computer Configuration"

    config ESP_WIFI_SSID
        string "WiFi SSID"
        default "undefined"
        help
            SSID (network name)

    config ESP_WIFI_PASSWORD
        string "WiFi password"
        default "undefined"
        help
            WiFi password (WPA or WPA2)

    config ESP_WIFI_MAXIMUM_CONNECTION_RETRY
        int "WiFi maximum connection retry attempts"
        default 5
        help
            Set the maximum retry attempts for client connection to network AP

    config BNO055_SDA_GPIO
        int "GPIO pin number for BNO055 SDA"
        range 0 34
        default 16
        help
            GPIO pin number for the BNO055's SDA connection.

    config BNO055_SCL_GPIO
        int "GPIO pin number for BNO055 SCL"
        range 0 34
        default 17
        help
            GPIO pin number for the BNO055's SCL connection.

endmenu
```

## sdkconfig.defaults
```kconfig
#
# Flight Computer Configuration
#
CONFIG_BNO055_SDA_GPIO=16
CONFIG_BNO055_SCL_GPIO=17
```
